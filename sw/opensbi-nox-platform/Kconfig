## sw/opensbi-nox-platform/Kconfig
```kconfig
# SPDX-License-Identifier: BSD-2-Clause
# NoX platform Kconfig — pull in only the drivers we use

config PLATFORM_NOX
	bool
	select SERIAL_UART8250
	select IPI_MSWI
	select TIMER_MTIMER
	select IRQCHIP_PLIC
	default y
```

## sw/opensbi-nox-platform/configs/defconfig
```kconfig
CONFIG_SERIAL_UART8250=y
CONFIG_IPI_MSWI=y
CONFIG_TIMER_MTIMER=y
CONFIG_IRQCHIP_PLIC=y
```
